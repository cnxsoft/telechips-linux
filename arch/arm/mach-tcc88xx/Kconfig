## arch/arm/mach-tcc88xx/Kconfig
```kconfig
if ARCH_TCC88XX

comment "TCC Board Type"

config MACH_TCC8800
	bool "TCC8800 evaluation board"
	depends on ARCH_TCC88XX
	help
	  Support for the TCC8800 evaluation board. Say Y here if you
	  have such a device.


config MACH_M801_88
	bool "M801 board"
	depends on ARCH_TCC88XX
	help
	  Support for the TCC8800 evaluation board. Say Y here if you
	  have such a device.

config MACH_M803
        bool "M803 board"
        depends on ARCH_TCC88XX
        help
          Support for the TCC8800 evaluation board. Say Y here if you
          have such a device.

config MACH_TCC8800ST
	bool "TCC8800ST board"
	depends on ARCH_TCC88XX
	help
	  Support for the TCC8800ST evaluation board. Say Y here if you
	  have such a device.

config CPU_HIGHSPEED
    bool "CPU high-speed clock"
    depends on ARCH_TCC88XX
    default n
    help
     Support for the TCC88xx demo board, Say Y here if you
     want to overclocking

config GPIO_CORE_VOLTAGE_CONTROL
	bool "Ctrl coreA/B voltage by gpio ports"
	depends on CPU_FREQ_DEFAULT_GOV_ONDEMAND && !REGULATOR
	default n
	help
	  Support for the TCC880X demo board.

config TCC_STB_MODE
	bool "TCC STB Mode"
        default n
	help
	  Support for the TCC93/88/8910 demo board, Say Y here if you STB
	  It change the memory configuration

config TCC_OUTPUT_STARTER
        bool "TCC OUTPUT show boot logo image on HDMI/CVBS/Component"
        depends on ARCH_TCC88XX
        default n
        help
          Support for the TCC93/88/8910 demo board, Say Y here if you want
          to show boot logo by using HDMI/CVBS/Component output

endif
```

## arch/arm/mach-tcc892x/Kconfig
```kconfig
if ARCH_TCC892X

choice
	prompt "TCC892x Board(Machine) Type"
	default MACH_TCC8920
	depends on ARCH_TCC892X
	help
	  Select TCC892x board type.

config MACH_TCC8920
	bool "TCC8920 evaluation board"
	help
	  Support for the TCC8920 evaluation board. Say Y here if you
	  have such a device.

config MACH_TCC8920ST
	bool "TCC8920 STB evaluation board"
	help
	  Support for the TCC8924 evaluation board. Say Y here if you
	  have such a device.

config MACH_M805_892X
	bool "M805_TCC8923 board"
	help
	  Support for the TCC8923 M805 board. Say Y here if you
	  have such a device.
endchoice

choice
	prompt "M805S_TCC892x Chipset Type"
	default TCC8923_0XA
	depends on MACH_M805_892X
	help
	  Select M805S_TCC892x Chipset type.

config M805S_8923_0XX
	bool "TCC8923_0XX Chipset"
	depends on MACH_M805_892X
	help
	  Support for the TCC8923-0XX chipset.

config M805S_8923_0XA
	bool "TCC8923_0XA Chipset"
	depends on MACH_M805_892X
	help
	  Support for the TCC8923-0XA chipset.

config M805S_8925_0XX
	bool "TCC8925_0XX Chipset"
	depends on MACH_M805_892X
	help
	  Support for the TCC8925-0XX chipset.
endchoice

choice
	prompt "TCC892x Chipset Wafer Type"
	default TCC892X_SS
	help
	  Select TC892x Chipset Wafer Type.

config TCC892X_SS
	bool "TCC892X_SS"
 	help
	  Support for the TCC892X_SS.

config TCC892X_NN
	bool "TCC892X_NN"
 	help
	  Support for the TCC892X_NN.
endchoice

choice
	prompt "TCC892x STB Board"
	default STB_BOARD_EV
	depends on MACH_TCC8920ST
	help
	  Select TCC892x STB Board Type.

config STB_BOARD_EV
	bool "TCC8920 STB evalution board"
	depends on MACH_TCC8920ST
	help
	  Support for TCC8920 STB Base Board.

config STB_BOARD_HDB892S
	bool "TCC8920 HDB892S board"
	depends on MACH_TCC8920ST
	help
	  Support for TCC8920 HD892S Board.

config STB_BOARD_HDB892F
        bool "TCC8920 HDB892F board"
        depends on MACH_TCC8920ST
        help
          Support for TCC8925 HD892F Board.

config STB_BOARD_DONGLE
	bool "TCC8925 HDMI dongle board"
	depends on MACH_TCC8920ST
	help
	  Support for TCC8925 HDMI Dongle Board.

config STB_BOARD_ISDBT_MODULE
	bool "TCC8925 ISDBT Module board"
	depends on MACH_TCC8920ST
	help
	  Support for TCC8925 ISDBT Module board.
endchoice

choice
	prompt "TCC892x MiniSTB Clock Mode"
	default HDB892X_CLOCK_NORMAL_SPEED
	depends on (STB_BOARD_HDB892S || STB_BOARD_HDB892F)
	help
	  Select the Clock Mode of TCC8925 HDMI Dongle Board.

config HDB892X_CLOCK_HIGH_SPEED
	bool "High Speed Mode"
	depends on (STB_BOARD_HDB892S || STB_BOARD_HDB892F)
	help
	  Support High Speed Mode for TCC892x HDB892x Board.

config HDB892X_CLOCK_NORMAL_SPEED
	bool "Normal Speed Mode"
	depends on (STB_BOARD_HDB892S || STB_BOARD_HDB892F)
	help
	  Support Normal Speed Mode for TCC8925 HDB892x Board.
endchoice

choice
	prompt "TCC892x HDMI Dongle Clock Mode"
	default HDMI_DONGLE_CLOCK_NORMAL_SPEED
	depends on STB_BOARD_DONGLE
	help
	  Select the Clock Mode of TCC8925 HDMI Dongle Board.

config HDMI_DONGLE_CLOCK_HIGH_SPEED
	bool "High Speed Mode"
	depends on STB_BOARD_DONGLE
	help
	  Support High Speed Mode for TCC8925 HDMI Dongle Board.

config HDMI_DONGLE_CLOCK_NORMAL_SPEED
	bool "Normal Speed Mode"
	depends on STB_BOARD_DONGLE
	help
	  Support Normal Speed Mode for TCC8925 HDMI Dongle Board.
endchoice

choice
	prompt "TCC892x HDMI Dongle WiFi Chip"
	default HDMI_DONGLE_WIFI_REALTEK
	depends on STB_BOARD_DONGLE
	help
	  Select WiFi Chip of TCC8925 HDMI Dongle Board.

config HDMI_DONGLE_WIFI_ARTHEROS
	bool "Artheros AR6102/6103"
	depends on STB_BOARD_DONGLE
	help
	  Support Artheros AR6102/6103 for TCC8925 HDMI Dongle Board.

config HDMI_DONGLE_WIFI_REALTEK
	bool "Realtek RTL8188/8189"
	depends on STB_BOARD_DONGLE
	help
	  Support Realtek RTL8188/8189 for TCC8925 HDMI Dongle Board.

config HDMI_DONGLE_WIFI_BROADCOM
	bool "Broadcom BCM4330"
	depends on STB_BOARD_DONGLE
	help
	  Support Broadcom BCM4330 for TCC8925 HDMI Dongle Board.
endchoice

config CPU_HIGHSPEED
    bool "CPU high-speed clock"
    depends on ARCH_TCC892X
    default n
    help
     Support for the TCC892x demo board, Say Y here if you
     want to overclocking

config GPIO_CORE_VOLTAGE_CONTROL
	bool "Ctrl coreA/B voltage by gpio ports"
	depends on CPU_FREQ_DEFAULT_GOV_ONDEMAND && !REGULATOR
	default n
	help
	  Support for the TCC892X demo board.

config TCC_STB_MODE
	bool "TCC STB Mode"
        default n
	help
	  Support for the TCC93/88/8920 demo board, Say Y here if you STB
	  It change the memory configuration

config TCC_OUTPUT_STARTER
        bool "TCC OUTPUT show boot logo image on HDMI/CVBS/Component"
        depends on ARCH_TCC892X
        default n
        help
          Support for the TCC93/88/8920 demo board, Say Y here if you want
          to show boot logo by using HDMI/CVBS/Component output

endif
```

## arch/arm/plat-tcc/Kconfig
```kconfig
if ARCH_TCC

choice
	prompt "TCC Processor Family"
config ARCH_TCC88XX
	bool "TCC88xx"
	select AEABI
	select ARCH_HAS_CPUFREQ
	select CPU_V7
	select VFP
	select NEON
	select HAVE_CLK
	select ARM_L1_CACHE_SHIFT_6
	select GENERIC_GPIO
	select ARCH_REQUIRE_GPIOLIB
	select GENERIC_TIME
	select GENERIC_CLOCKEVENTS

config ARCH_TCC892X
	bool "TCC892x"
	select AEABI
	select ARCH_HAS_CPUFREQ
	select CPU_V7
	select VFP
	select NEON
	select HAVE_CLK
	select GENERIC_GPIO
	select ARCH_REQUIRE_GPIOLIB
	select GENERIC_TIME
	select GENERIC_CLOCKEVENTS

endchoice

choice
	prompt "TCC88xx series"
	depends on ARCH_TCC88XX
	default TCC8801

config TCC8801
	bool "TCC8801"

config TCC8803
	bool "TCC8803"

endchoice

comment "DRAM Settings"

config MEM_CLK_SYNC_MODE
	bool "Memory clock Synchronous mode"
	depends on ARCH_TCC93XX
	default n
	help
	  It's used for generating memory bus clock
	  in synchronous clock mode.

choice
	prompt "DRAM Memory Type"
	default DRAM_DDR2
	help
	  Select DRAM Type.

config DRAM_MDDR
	bool "DRAM mDDR(LPDDR)"

config DRAM_LPDDR2
	bool "DRAM LPDDR2"

config DRAM_DDR2
	bool "DRAM DDR2"

config DRAM_DDR3
	bool "DRAM DDR3"

endchoice

choice
	bool "DRAM Memory Size"
	default TCC_MEM_256MB
	help
	  System memory size.

config TCC_MEM_1024MB
	bool "1024MB"

config TCC_MEM_512MB
	bool "512MB"

config TCC_MEM_256MB
	bool "256MB"

config TCC_MEM_128MB
	bool "128MB"

endchoice

choice
	bool "DRAM BandWidth"
	depends on (DRAM_DDR2 && ARCH_TCC92XX) || (DRAM_DDR3 && ARCH_TCC892X)
	default DRAM_32BIT_USED
	help
	  select DRAM BandWidth.

config DRAM_16BIT_USED
	bool "16Bit"

config DRAM_32BIT_USED
	bool "32Bit"

endchoice

choice
  bool "mDDR (LPDDR) settings"
  depends on DRAM_MDDR
  default MDDR_H5MS1G62MFP

config MDDR_H5MS1G62MFP
  bool "Hynix H5MS1G62MFP (166MHz)"

config MDDR_K4X1G163PE
  bool "Samsung K4X1G163PE (200MHz)"

config MDDR_EHD013091MA60
  bool "ELPIDA EHD013091MA-60 (166MHz)"

config MDDR_MT46H64M32LF
  bool "MICRON MT46H64M32LF (166MHz)"

endchoice

choice
  bool "LPDDR2 settings"
  depends on DRAM_LPDDR2
  default LPDDR2_K4P4G324EB_AGC1

config LPDDR2_K4P4G324EB_AGC1
  depends on TCC_MEM_512MB
  bool "SAMSUNG K4P4G324EB AGC1"

endchoice

choice
  bool "DDR2 settings"
  depends on DRAM_DDR2
  default DDR2_HXB18T2G160AF

config DDR2_K4T1G164QQ
  bool "Samsung K4T1G164QQ"

config DDR2_K4T1G164QF_BCE7
  bool "Samsung K4T1G164QF-BCE7"

config DDR2_HY5PS1G1631CFPS6
  bool "Hynix HY5PS1G1631C FP-S6"

config DDR2_HY5PS1G831CFPS6
  bool "Hynix HY5PS1G831C FP-S6"

config DDR2_HXB18T2G160AF
  bool "SCSemicon HXB18T2G160AF-25D"

config DDR2_E1108AEBG
  bool "ELPIDA E1108AEBG"

config DDR2_E2116ABSE
  bool "ELPIDA E2116ABSE"

config DDR2_MT47H128M8
  bool "Micron MT47H128M8"

config DDR2_K4T1G164QE_HCF7
  bool "Samsung K4T1G164QE-HCF7"

config DDR2_K4T1G084QF_BCE7
  bool "Samsung K4T1G084QF-BCE7"

config DDR2_CT83486C1
  bool "Chipsip CT83486C1"

config DDR2_MT47H256M8EB25E
  depends on TCC_MEM_1024MB
  bool "Micron MT47H256M8EB-25E"

endchoice

choice
  bool "DDR3 settings"
  depends on DRAM_DDR3
  default DDR3_K4B1G1646E_HCH9

config DDR3_K4B2G1646C_HCK0
  bool "Samsung K4B2G1646C-HCK0"

config DDR3_K4B1G1646E_HCH9
  bool "Samsung K4B1G1646E-HCH9"

config DDR3_H5TQ2G63BFR_H9C
  bool "Hynix DDR3_H5TQ2G63BFR-H9C"

config DDR3_H5TQ2G63BFR_PBC
  bool "Hynix DDR3_H5TQ2G63BFR-PBC"

config DDR3_H5TQ1G83BFR_H9C
  bool "Hynix DDR3_H5TQ1G83BFR_H9C"

config DDR3_H5TQ2G83BFR_H9C
  bool "Hynix DDR3_H5TQ2G83BFR_H9C"

config DDR3_H5TQ2G83BFR_PBC
  bool "Hynix DDR3_H5TQ2G83BFR_PBC"

config DDR3_IN5CB256M8BN_CG
  bool "Innoways IN5CB256M8BN_CG"

config DDR3_NT5CB256M8GN_CG
  bool "Nanya NT5CB256M8GN_CG"

config DDR3_H5TC4G83MFR_H9A
  bool "Hynix DDR3_H5TC4G83MFR_H9A"

endchoice

choice
	prompt "RTC circuit configration"
	depends on ARCH_TCC88XX
	default TCC88XX_RTC_EXTERNAL_PATH
	help
	  If RTC_PMWKUP and GPIO(C28) is connected, select <TCC88XX RTC external path>.
	  If you choose <TCC88XX RTC external path>, Shut-down mode will be used at SUSPEND status.
	  In other case, Sleep mode will be used at SUSPEND status.
	  The current consumption of Shut-down mode is less than Sleep mode.
	  In other words, RTC_PMWKUP and GPIO(C28) should be connected on your circuit to select <TCC88XX RTC external path>.

config TCC88XX_RTC_INTERNAL_PATH
	bool "TCC88XX RTC internal path"
	help
	  If there is no circuit for RTC, select <TCC88XX RTC internal path>.
config TCC88XX_RTC_EXTERNAL_PATH
	bool "TCC88XX RTC external path"
	help
	  If RTC_PMWKUP and GPIO(C28) is connected, select <TCC88XX RTC external path>.

endchoice

config TCC_ECID_SUPPORT
	bool "TCC ECID(CPU ID) SUPPORT"
        default n
	help
	  Support for the TCCXXXX demo board, Say Y here if you use ECID

endif


if ARCH_TCC_926

menu "Telechips ARM926-based CPUs"
choice
	prompt "Telechips CPU type:"
	default ARCH_TCC8K

config ARCH_TCC8K
	bool TCC8000
	select USB_ARCH_HAS_OHCI
	help
	  Support for Telechips TCC8000 systems

endchoice

source "arch/arm/mach-tcc8k/Kconfig"

endmenu
endif
```

## drivers/gps/Kconfig
```kconfig
menuconfig GPS
	bool "GPS Driver"

config GPS_JGR_SC3_S
	bool "GPS JGR SC3 S Module"
	depends on GPS
```

## drivers/gpu/mali/Kconfig
```kconfig
config MALI_GPU
	tristate "Mali GPU device driver"
	depends on FB && ARM
	---help---
	  Device driver for ARM Mali-200 and Mali-400 GPUs.

config GPU_BUS_SCALING
	bool "Use GPU bus scaling"
	default n
	depends on MALI_GPU
	---help---
	   Use GPU bus scaling for Mali GPU

config MALI_OS_MEMORY
	bool "Use OS memory"
	default y
	depends on MALI_GPU
	---help---
	   Use OS memory for Mali GPU

config MALI_MEMORY_SIZE
	int "Mali memory size"
	default 300
	depends on MALI_GPU
	----help---
	    Memory size for Mali GPU

config MALI_UMP
	tristate "UMP device driver"
	depends on MALI_GPU
	default y
	---help---
	  Device driver for ARM Unified Memory Provider (UMP).

config UMP_OS_MEMORY
	bool "Use OS memory"
	default y
	depends on MALI_UMP
	---help---
	   Use OS memory for UMP

config UMP_MEMORY_ADDRESS
	int "UMP memory address"
	default 0
	depends on MALI_UMP
	---help---
	   Memory address for UMP

config UMP_MEMORY_SIZE
	int "UMP memory size"
	default 48
	depends on MALI_UMP
	---help---
	   Memory size for UMP in MB
```

## drivers/i-tv/Kconfig
```kconfig
#
# iTV device configuration
#

menu "iTV multimedia devices"
	depends on HAS_IOMEM

comment "iTV core support"

#
# iTV Core
#
config iTV_CORE
	tristate "iTV for Linux"

source "drivers/i-tv/i-platform/Kconfig"

source "drivers/i-tv/i-adapter/Kconfig"

comment "Module"
	depends on iTV_CORE

menuconfig iTV_MODULE
	bool "Module configurations"
	depends on iTV_CORE
	default y

source "drivers/i-tv/i-demux/Kconfig"
source "drivers/i-tv/i-frontend/Kconfig"

endmenu
```

## drivers/i-tv/i-adapter/Kconfig
```kconfig
# 
# Adapter configurations
#

comment "Adapter"
	depends on iTV_CORE

menuconfig iTV_ADAPTER
	bool "Adapter configurations"
	depends on iTV_CORE
	default y

source "drivers/i-tv/i-adapter/i-direct/Kconfig"
source "drivers/i-tv/i-adapter/i-pci/Kconfig"
source "drivers/i-tv/i-adapter/i-usb/Kconfig"
```

## drivers/i-tv/i-adapter/i-direct/Kconfig
```kconfig
# 
# Direct adapter configurations
#

config iTV_ADAPTER_DIRECT
	tristate "Direct adapter for i2c controlled devices"
	depends on iTV_ADAPTER && I2C
	default iTV_CORE
```

## drivers/i-tv/i-adapter/i-pci/Kconfig
```kconfig
# 
# PCI adapter configurations
#

config iTV_ADAPTER_PCI
	tristate "PCI adapter for pci connectable devices"
	depends on iTV_ADAPTER && PCI
```

## drivers/i-tv/i-adapter/i-usb/Kconfig
```kconfig
# 
# USB adapter configurations
#

config iTV_ADAPTER_USB
	tristate "USB adapter for usb connectable devices"
	depends on iTV_ADAPTER && USB
```

## drivers/i-tv/i-demux/Kconfig
```kconfig
# 
# Demux module configurations
#

comment "Demux"
	depends on iTV_MODULE

menuconfig iTV_DEMUX_MODULE
	bool "Demux module configurations"
	depends on iTV_MODULE
	default iTV_MODULE

if iTV_DEMUX_MODULE

config iTV_DEMUX_MODULE_TS
	tristate "Enable TS demux module"
	default iTV_CORE

endif	# iTV_DEMUX_MODULE
```

## drivers/i-tv/i-frontend/Kconfig
```kconfig
# 
# Frontend and Tuner module configurations
#

comment "Frontend"
	depends on iTV_MODULE

menuconfig iTV_FRONTEND_MODULE
	bool "Frontend module configurations"
	depends on iTV_MODULE
	default iTV_MODULE

if iTV_FRONTEND_MODULE

comment "Demodulators"

menuconfig iTV_FE_DEMOD_MODULE
	bool "Demodulator module configurations"
	default iTV_FRONTEND_MODULE

if iTV_FE_DEMOD_MODULE

comment "ATSC"

config iTV_FE_DEMOD_MODULE_S5H1411
	tristate "Enable S5H1411 demodulator module"
	depends on iTV_FRONTEND_MODULE
	default iTV_CORE

config iTV_FE_DEMOD_MODULE_LGDT3305
	tristate "Enable LGDT3305 demodulator module"
	depends on iTV_FRONTEND_MODULE
	#default iTV_CORE

endif	# iTV_FE_DEMOD_MODULE

comment "Tuners"

menuconfig iTV_FE_TUNER_MODULE
	bool "Tuner module configurations"
	default iTV_FRONTEND_MODULE

if iTV_FE_TUNER_MODULE

config iTV_FE_TUNER_MODULE_XC5000
	tristate "Enable XC5000 tuner module"
	depends on iTV_FRONTEND_MODULE
	default iTV_CORE

config iTV_FE_TUNER_MODULE_XC5000C
	tristate "Enable XC5000C tuner module"
	depends on iTV_FRONTEND_MODULE
	#default iTV_CORE

config iTV_FE_TUNER_MODULE_FQD1136
	tristate "Enable FQD1136 tuner module"
	depends on iTV_FRONTEND_MODULE
	#default iTV_CORE

config iTV_FE_TUNER_MODULE_FJ2148
	tristate "Enable FJ2148 tuner module"
	depends on iTV_FRONTEND_MODULE
	#default iTV_CORE

endif	# iTV_FE_TUNER_MODULE

endif	# iTV_FRONTEND_MODULE
```
