## drivers/i-tv/i-frontend/i-tuner/Kconfig
```kconfig
config iTV_ENABLE_XC5000_MODULE
	tristate "Enable xc5000 tuner module"
	depends on iTV_MODULE

config iTV_ENABLE_FQD1136_MODULE
	tristate "Enable fqd1136 tuner module"
	depends on iTV_MODULE

config iTV_ENABLE_FJ2148_MODULE
	tristate "Enable fj2148 tuner module"
	depends on iTV_MODULE
```

## drivers/i-tv/i-platform/Kconfig
```kconfig
# 
# Platform configurations
#

config iTV_PLATFORM
	tristate
	depends on iTV_CORE
	default iTV_CORE

source "drivers/i-tv/i-platform/i-telechips/Kconfig"
```

## drivers/i-tv/i-platform/i-telechips/Kconfig
```kconfig
# 
# Telechips platform configrations
#

config iTV_PLATFORM_TCCXXXX
	tristate
	depends on iTV_PLATFORM && ARCH_TCC
	default iTV_PLATFORM
```

## drivers/media/video/tcccam/Kconfig
```kconfig
config VIDEO_TCCXX_CAMERA
	tristate "Telechips TCCXXX Camera support (EXPERIMENTAL)"
	select VIDEOBUF_GEN
	select VIDEOBUF_DMA_SG
	select VIDEOBUF_VMALLOC
	depends on VIDEO_DEV
	help
	  V4L2 camera driver support for TCCXXX.

config VIDEO_ENABLE_CAMERA_WITH_MAX_CLK
	tristate "Enable Camera with max-clock"
	depends on VIDEO_TCCXX_CAMERA
	help
	   Operate camera with max-clock regardless of DVFS.

config VIDEO_CAMERA_SENSOR
        tristate "CAMERA sensor support"
        depends on VIDEO_TCCXX_CAMERA
        help
           camera sensor support

config VIDEO_DUAL_CAMERA_SUPPORT
	tristate "Enable Telechips Dual-Camera"
	depends on VIDEO_CAMERA_SENSOR
	help
	   tcc dual-camera suport

config VIDEO_DUAL_BACK_CAMERA_SUPPORT
	tristate "Select Telechips Back-Camera"
	depends on VIDEO_DUAL_CAMERA_SUPPORT
	help
	   tcc dual-camera suport
	
config VIDEO_CAMERA_SENSOR_MT9P111
	tristate "MT9P111 5MP-sensor support"
	depends on VIDEO_DUAL_BACK_CAMERA_SUPPORT
	help
	   camera sensor support for 5MP		

config VIDEO_CAMERA_SENSOR_MT9T111
        tristate "MT9T111 3MP-sensor support"
        depends on VIDEO_DUAL_BACK_CAMERA_SUPPORT
        help
           camera sensor support for 3MP
config VIDEO_CAMERA_SENSOR_S5K5CAGA
        tristate "S5K5CAGA 3MP-sensor support"
        depends on VIDEO_DUAL_BACK_CAMERA_SUPPORT
        help
           camera sensor support for 3MP
 
config VIDEO_CAMERA_SENSOR_MT9D112
        tristate "MT9D112 2MP-sensor support"
        depends on VIDEO_DUAL_BACK_CAMERA_SUPPORT
        help
           camera sensor support for 2MP
	   
config VIDEO_DUAL_FRONT_CAMERA_SUPPORT
	tristate "Select Telechips Front-Camera"
	depends on VIDEO_DUAL_CAMERA_SUPPORT
	help
	   tcc dual-camera suport

#config VIDEO_CAMERA_SENSOR_MT9D112
#        tristate "MT9D112 2MP-sensor support"
#        depends on VIDEO_DUAL_FRONT_CAMERA_SUPPORT
#        help
#           camera sensor support for 2MP
	   
config VIDEO_CAMERA_SENSOR_MT9M113
 tristate "MT9M113 1.3MP-sensor support"
 depends on VIDEO_DUAL_FRONT_CAMERA_SUPPORT
 help
    camera sensor support for 1.3MP

config VIDEO_CAMERA_SENSOR_SR130PC10
 tristate "SR130PC10 1.3MP-sensor support"
 depends on VIDEO_DUAL_FRONT_CAMERA_SUPPORT
 help
    camera sensor support for 1.3MP
config VIDEO_CAMERA_SENSOR_OV7690
        tristate "OV7690 VGA-sensor support"
        depends on VIDEO_DUAL_FRONT_CAMERA_SUPPORT
        help
           camera sensor support for VGA

config VIDEO_CAMERA_SENSOR_SIV100B
        tristate "SIV100B VGA-sensor support"
        depends on VIDEO_DUAL_FRONT_CAMERA_SUPPORT
        help
           camera sensor support for VGA

config VIDEO_SINGLE_CAMERA_SUPPORT
	tristate "Enable Telechips Single-Camera"
	depends on VIDEO_CAMERA_SENSOR
	help
	   tcc dual-camera suport
	   
config VIDEO_CAMERA_SENSOR_MT9D112
	tristate "MT9D112 2MP-sensor support"
	depends on VIDEO_SINGLE_CAMERA_SUPPORT
	help
	   camera sensor support for 2MP

config VIDEO_CAMERA_SENSOR_SIV100B
        tristate "SIV100B VGA-sensor support"
        depends on VIDEO_SINGLE_CAMERA_SUPPORT
        help
           camera sensor support for VGA

config VIDEO_CAMERA_SENSOR_OV3640
	tristate "OV3640 3MP-sensor support"
	depends on VIDEO_SINGLE_CAMERA_SUPPORT
	help
	   camera sensor support for 3MP

config VIDEO_CAMERA_SENSOR_S5K4BAFB
	tristate "S5K4BAFB 2MP-sensor support"
	depends on VIDEO_SINGLE_CAMERA_SUPPORT
	help
	   camera sensor support for 2MP

config VIDEO_CAMERA_SENSOR_MV9317
	tristate "MV9317 3MP-sensor support"
	depends on VIDEO_SINGLE_CAMERA_SUPPORT
	help
	   camera sensor support for 3MP

config VIDEO_CAMERA_SENSOR_MT9P111
	tristate "MT9P111 5MP-sensor support"
	depends on VIDEO_SINGLE_CAMERA_SUPPORT
	help
	   camera sensor support for 5MP	  

config VIDEO_CAMERA_SENSOR_MT9T111
        tristate "MT9T111 3MP-sensor support"
        depends on VIDEO_SINGLE_CAMERA_SUPPORT
        help
           camera sensor support for 3MP

config VIDEO_CAMERA_SENSOR_MT9T113
        tristate "MT9T113 3MP-sensor support"
        depends on VIDEO_SINGLE_CAMERA_SUPPORT
        help
           camera sensor support for 3MP

config VIDEO_CAMERA_SENSOR_S5K5CAGA
        tristate "S5K5CAGA 3MP-sensor support"
        depends on VIDEO_SINGLE_CAMERA_SUPPORT
        help
           camera sensor support for 3MP
config VIDEO_CAMERA_SENSOR_SR130PC10
        tristate "SR130PC10 1.3MP-sensor support"
        depends on VIDEO_SINGLE_CAMERA_SUPPORT
        help
           camera sensor support for 1.3MP
config VIDEO_CAMERA_SENSOR_AIT848_ISP
	tristate "AIT848_ISP 5MP-sensor support"
	depends on VIDEO_SINGLE_CAMERA_SUPPORT
	help
	   camera sensor support for 5MP

config VIDEO_CAMERA_SENSOR_AIT848_FWDN_EN
	tristate "FirmWare Download support"
	depends on VIDEO_CAMERA_SENSOR && VIDEO_CAMERA_SENSOR_AIT848_ISP
	help
	   camera sensor support for 5MP	  

config VIDEO_CAMERA_SENSOR_ISX006
        tristate "ISX006 5MP-sensor support"
        depends on VIDEO_SINGLE_CAMERA_SUPPORT
        help
           camera sensor support for 5MP

config VIDEO_CAMERA_SENSOR_GT2005	
	tristate "GT2005 2MP-sensor support"
	depends on VIDEO_SINGLE_CAMERA_SUPPORT
	help
	   camera sensor support for 2MP

config VIDEO_CAMERA_SENSOR_OV7690
        tristate "OV7690 VGA-sensor support"
        depends on VIDEO_SINGLE_CAMERA_SUPPORT
        help
           camera sensor support for VGA

config VIDEO_CAMERA_NEXTCHIP_TEST           
        tristate "NEXTCHIP_TEST support"
        depends on VIDEO_SINGLE_CAMERA_SUPPORT
        help
           camera sensor support for NEXTCHIP_TEST

config VIDEO_CAMERA_SENSOR_MT9M113
        tristate "MT9M113 1.3MP-sensor support"
        depends on VIDEO_SINGLE_CAMERA_SUPPORT
        help
           camera sensor support for 1.3MP

config USE_ISP
	tristate "ISP support"
	depends on VIDEO_TCCXX_CAMERA
	help
	   camera sensor support

source drivers/media/video/tcccam/atv/Kconfig
```

## drivers/media/video/tcccam/atv/Kconfig
```kconfig
config VIDEO_TCCXX_ATV
	tristate "Telechips TCCXXX Analog TV support (EXPERIMENTAL)"
	select VIDEOBUF_GEN
	select VIDEOBUF_DMA_SG
	select VIDEOBUF_VMALLOC
	depends on VIDEO_DEV
	help
	  V4L2 Analog TV driver support for TCCXXX.
	
config VIDEO_ATV_SENSOR
	tristate "ATV sensor support"
	depends on VIDEO_TCCXX_ATV
	help
	   atv sensor support

config VIDEO_ATV_SENSOR_RDA5888
	tristate "RDA5888 ATV-sensor support"
	depends on VIDEO_ATV_SENSOR
	help
	   atv sensor support for rda5888

config VIDEO_ATV_SENSOR_TVP5150
        tristate "TVP5150 ATV-sensor support"
        depends on VIDEO_ATV_SENSOR
        help
           atv sensor support for TVP5150












































 
```

## drivers/net/tcc_gmac/Kconfig
```kconfig
#
#Telechips
#
config TCC_GMAC
	tristate "Telechips 10/100/1000 Ethernet Driver"
	depends on ARCH_TCC88XX || ARCH_TCC93XX || ARCH_TCC892X
	select CRC32
	select MII 
	---help---
	  Support for Telechips TCC9300 10/100/1000 Ethernet Driver

config TCC_GMAC_DA
    bool "Rx has priority over Tx"
    depends on TCC_GMAC
    default y

choice
    prompt "Phy Interface"
    depends on TCC_GMAC
    default TCC_GMAC_RGMII_MODE
    help 
        Select TCC_GMAC Phy Interface Mode
config TCC_GMAC_MII_MODE
    bool "MII"
    help 
        Select MII Phy Interface Mode
config TCC_GMAC_GMII_MODE
    bool "GMII"
    help 
        Select GMII Phy Interface Mode
config TCC_GMAC_RGMII_MODE
    bool "RGMII"
    help 
        Select RGMII Phy Interface Mode
endchoice

config TCC_GMAC_SET_MAC_FROM_CHIP
    bool "Mac address is set by reading TCC Chip ID"
    depends on TCC_GMAC
    default n
```

## drivers/switch/Kconfig
```kconfig
menuconfig SWITCH
	tristate "Switch class support"
	help
	  Say Y here to enable switch class support. This allows
	  monitoring switches by userspace via sysfs and uevent.

if SWITCH

config SWITCH_GPIO
	tristate "GPIO Swith support"
	depends on GENERIC_GPIO
	help
	  Say Y here to enable GPIO based switch support.

config SWITCH_GPIO_TCC
	tristate "GPIO Swith support(TCC)"
	depends on MACH_M57TE || MACH_M801_88 || MACH_M803 || MACH_M805_892X
	help
	  Say Y here to enable GPIO based switch support.

endif # SWITCH
```

## drivers/usb/dwc_otg/Kconfig
```kconfig
#
# Synopsys DWC OTG Controller Drivers
#       for Telechips System-on-Chips
#

comment "Telechips DWC OTG Controller Drivers"
	depends on ARCH_TCC

config TCC_DWC_OTG
	tristate "Telechips DWC OTG support"
	---help---
	  Telechips USB OTG Controller driver. 
	  Synopsys DesignWare Hi-Speed USB On-The-Go (OTG) Core used on the Telechips SoC.
	select USB_OTG

#---------------------------------------------------------------
# Telechips DWC OTG Controller 0
#---------------------------------------------------------------
config TCC_DWC_OTG0
	depends on TCC_DWC_OTG
	bool "Telechips DWC OTG Controller 0"
	---help---
	  If you say Y here, the DWC OTG system will use Controller 0.


#---------------------------------------------------------------
# Telechips DWC OTG Controller 1
#---------------------------------------------------------------
config TCC_DWC_OTG1
	depends on TCC_DWC_OTG && (MACH_TCC9300 || MACH_TCC9300CM || MACH_TCC9300ST)
	bool "Telechips DWC OTG Controller 1"
	---help---
	  If you say Y here, the DWC OTG system will use Controller 0.

#---------------------------------------------------------------
# DWC_OTG Mode
#---------------------------------------------------------------
choice
	prompt "Telechips DWC OTG driver version"
	depends on TCC_DWC_OTG
	default TCC_DWC_OTG_V281A
	help
	  Select DWC_OTG driver version.
	  In case of TCC93X, default version is v2.81a. 

config TCC_DWC_OTG_V281A
	bool "DWC_OTG V2.81a"
	help
	  dwc_otg driver version 2.81a

endchoice

choice
	prompt "Telechips DWC OTG mode"
	depends on TCC_DWC_OTG
	depends on !(TCC_DWC_OTG0 && TCC_DWC_OTG1)
	default TCC_DWC_OTG_DUAL_ROLE
	help
	  Select Telechips DWC OTG mode, 
	  OTG Dual-role or OTG Host only or OTG Device only mode.

config TCC_DWC_OTG_DUAL_ROLE
	bool "OTG Dual-role mode"
	select USB_GADGET
	help
	  Telechips DWC OTG Dual-role mode driver.	

config TCC_DWC_OTG_DEVICE_ONLY
	bool "OTG Device only mode"
	select USB_GADGET
	help
	  Telechips DWC OTG Device _only_ mode driver.

config TCC_DWC_OTG_HOST_ONLY
	bool "OTG Host only mode"
	help
	  Telechips DWC OTG Host _only_ mode driver.

endchoice

choice
	prompt "Telechips DWC OTG mode"
	depends on TCC_DWC_OTG
	depends on TCC_DWC_OTG0 && TCC_DWC_OTG1
	default TCC_DWC_OTG_2PORT_0OTG_1GADGET
	help
	  Select Telechips DWC OTG mode, 
	  OTG Dual-role or OTG Host only or OTG Device only mode.

config TCC_DWC_OTG_2PORT_0OTG_1HOST
	bool "Controller0 OTG, Controller1 Host"
	select USB_GADGET
	help
	  DWC OTG Controller0 is Dual-role mode.
	  DWC OTG Controller1 is Host only mode.

config TCC_DWC_OTG_2PORT_0HOST_1OTG
	bool "Controller0 Host, Controller1 OTG"
	select USB_GADGET
	help
	  DWC OTG Controller0 is Host only mode.
	  DWC OTG Controller1 is Dual-role mode.

endchoice

#---------------------------------------------------------------
# Misc
#---------------------------------------------------------------
config TCC_DWC_OTG_DEBUG
	depends on TCC_DWC_OTG
	bool "Enable debugging messages"
	default n
	help
	  This enables Telechips DWC OTG debugging.
 
config TCC_DWC_HS_ELECT_TST
	depends on TCC_DWC_OTG
	bool "Embedded High-speed Host Electrical Test Procedure"
	default n
	help
	  Enable "Embedded High-speed Host Electrical Test Procedure"
	  To facilitate complicance testing, host controllers, hubs, 
	  and high-speed capable functions must support this test modes.
	  This test was described in Section 7.1.20 of [USB2.0]

#---------------------------------------------------------------
# USB-to-SATA
#---------------------------------------------------------------
config TCC_USB_TO_SATA
	depends on MACH_TCC8920ST
	bool "Telechips USB-to-SATA support"
	default n
	help
	  This enables SATA interface by using USB-to-SATA chip in TCC892x STB solution.
```
